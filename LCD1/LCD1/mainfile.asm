/*
 * Assignment2.asm
 *
 *  Created: 23-01-2015 13:46:28
 *   Author: Thyagu
 */ 

 .INCLUDE "M32DEF.INC"
 .ORG 0x00

 .EQU LCD_DPRT = PORTA
 .EQU LCD_CPRT = PORTB
 .EQU LCD_DDDR = DDRA
 .EQU LCD_CDDR = DDRB
 .EQU LCD_DPIN = PINA
 .EQU LCD_CPIN = PINB
 .EQU LCD_RS = 0
 .EQU LCD_RW = 1
 .EQU LCD_EN = 2

 ; Initializing stack pointer
			LDI R20, HIGH(RAMEND)
			OUT SPH, R20
			LDI R20, LOW(RAMEND)
			OUT SPL, R20

			LDI R16, 0xFF
			OUT LCD_DDDR, R16
			OUT LCD_CDDR, R16
			CBI LCD_CPRT, LCD_EN
			CALL DELAY_2ms
			LDI R16, 0x38
			CALL CMDWRT
			CALL DELAY_2ms
			LDI R16, 0x0E
			CALL CMDWRT
			CALL DELAY_2ms
			LDI R16, 0x01
			CALL CMDWRT
			CALL DELAY_2ms	
			LDI R16, 0x06
			CALL CMDWRT
			

L1:			LDI ZH, HIGH(MYDATA<<1)
			LDI ZL, LOW(MYDATA<<1)

			LDI R17, 0
L2:			INC R17
			CPI R17, 2
			BREQ NEXTLINE
			LPM R16, Z+
			INC R17
			CPI R16, 0
			BREQ HERE
			CALL DATAWRT
			RJMP L2
HERE:		JMP HERE

NEXTLINE:	LDI R16, 0x0E
			CALL CMDWRT
			CALL DELAY_2ms
			LDI R16, 0x06
			CALL CMDWRT
			CALL DELAY_2ms
			LDI R16, 0xC0
			CALL CMDWRT
			CALL DELAY_2ms
			
			RET



CMDWRT:		OUT LCD_DPRT, R16
			CBI LCD_CPRT, LCD_RS
			CBI LCD_CPRT, LCD_RW
			SBI LCD_CPRT, LCD_EN
			CALL SDELAY
			CBI LCD_CPRT, LCD_EN
			CALL DELAY_100us
			RET

DATAWRT:	OUT LCD_DPRT, R16
			SBI LCD_CPRT, LCD_RS
			CBI LCD_CPRT, LCD_RW
			SBI LCD_CPRT, LCD_EN
			CALL SDELAY
			CBI LCD_CPRT, LCD_EN
			CALL DELAY_100us
			RET

DELAY_2ms:	PUSH R17
			LDI R17, 20
D2:			CALL SDELAY
			DEC R17
			BRNE D2
			POP R17
			RET

DELAY_100us:PUSH R17
			LDI R17, 60
D1:			CALL SDELAY
			DEC R17
			BRNE D1
			POP R17
			RET

SDELAY:		NOP
			NOP
			RET					


.ORG 0x600		
MYDATA:		.DB "Anirud Piyush", 0	
